## meta-ahk/conf/layer.conf
```bitbake
# We have a conf and classes directory, add to BBPATH
BBPATH .= ":${LAYERDIR}"

# We have recipes-* directories, add to BBFILES
BBFILES += "${LAYERDIR}/recipes-*/*/*.bb \
            ${LAYERDIR}/recipes-*/*/*.bbappend"

BBFILE_COLLECTIONS += "meta-ahk"
BBFILE_PATTERN_meta-ahk = "^${LAYERDIR}/"
BBFILE_PRIORITY_meta-ahk = "9"

LAYERDEPENDS_meta-ahk = "core"
LAYERSERIES_COMPAT_meta-ahk = "kirkstone"
```

## meta-ahk/conf/machine/thin_client.conf
```bitbake
require thin_client.inc

DESCRIPTION = "Configuration for thin client for real hardware."

IMAGE_FSTYPES = "ext4 wic.gz"
```

## meta-ahk/conf/machine/thin_client.inc
```bitbake
DESCRIPTION = "Minimal configuration for x86_64, suitable for QEMU and bootable USB."

require conf/machine/genericx86-64.conf

MACHINE_FEATURES = "pcbios efi usbhost"

# Use ext4 as the default filesystem, which is compatible with USB drives
IMAGE_FSTYPES += "ext4 wic.gz"

# Set the image format and compression options
# 'wic.gz' creates a compressed .wic image, suitable for USB boot.
WKS_FILE = "ahk-thin_client.wks"

# Kernel and init system settings
PREFERRED_PROVIDER_virtual/kernel = "linux-yocto"
PREFERRED_PROVIDER_virtual/bootloader = "grub-efi"
PREFERRED_VERSION_linux-yocto = "5.15%"

# Additional bootloader settings
EFI_PROVIDER = "grub-efi"
GRUB_SERIAL_OUTPUT = "console"
GRUB_TIMEOUT = "5"
SERIAL_CONSOLE = "115200 ttyS0"
```

## meta-ahk/conf/machine/thin_client_qemu.conf
```bitbake
require conf/machine/thin_client.inc

IMAGE_FSTYPES:append = " wic.qcow2"
IMAGE_NAME_SUFFIX = "-qemu"

EXTRA_IMAGE_FEATURES = "debug-tweaks"

QB_SYSTEM_NAME = "qemu-system-x86_64"
QB_MACHINE = "-machine q35"
QB_CPU = "-cpu host"
QB_KERNEL_CMDLINE_APPEND = "console=ttyS0"
```

## meta-ahk/wic/ahk-thin_client.wks
```
part /boot --source bootimg-efi --sourceparams="loader=grub-efi" --fstype=vfat --label EFI --active --align 1024
part / --source rootfs --fstype=ext4 --label root --align 4096
```
